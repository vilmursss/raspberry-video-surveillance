## conf/bblayers.conf
```bitbake
POKY_BBLAYERS_CONF_VERSION = "2"

# Set the path to the external layers directory
EXTERNAL_LAYERS = "${@os.path.abspath(os.path.join(d.getVar('TOPDIR'), '..', 'external-layers'))}"

# Set the path to the project layers directory
PROJECT_LAYERS = "${@os.path.abspath(os.path.join(d.getVar('TOPDIR'), '..', 'project-layers'))}"

BBLAYERS ?= " \
  ${EXTERNAL_LAYERS}/poky/meta \
  ${EXTERNAL_LAYERS}/poky/meta-poky \
  ${EXTERNAL_LAYERS}/poky/meta-yocto-bsp \
  ${EXTERNAL_LAYERS}/meta-openembedded/meta-oe \
  ${EXTERNAL_LAYERS}/meta-openembedded/meta-multimedia \
  ${EXTERNAL_LAYERS}/meta-openembedded/meta-networking \
  ${EXTERNAL_LAYERS}/meta-openembedded/meta-python \
  ${EXTERNAL_LAYERS}/meta-raspberrypi \
  ${PROJECT_LAYERS}/meta-video-surveillance \
"
```

## conf/local.conf
```bitbake
include bitbake-env.conf

MACHINE = "raspberrypi3"
DISTRO = "poky"

EXTRA_IMAGE_FEATURES ?= "debug-tweaks"

# Core packages
IMAGE_INSTALL:append = " dropbear"
IMAGE_INSTALL:append = " util-linux"
IMAGE_INSTALL:append = " vim"

# Accept commercial licenses for GStreamer plugins
LICENSE_FLAGS_ACCEPTED += "commercial"

# Project specific packages
IMAGE_INSTALL:append = " usb-automount"
IMAGE_INSTALL:append = " wifi-connect"
IMAGE_INSTALL:append = " web-server"

# Enable UART
ENABLE_UART = "1"

# Enable Wifi
DISTRO_FEATURES:append = "  wifi"
IMAGE_INSTALL:append = " linux-firmware-bcm43430 python3-smbus bridge-utils hostapd iptables wpa-supplicant iw"

KERNEL_MODULE_AUTOLOAD:append = " brcmfmac brcmutil"
IMAGE_INSTALL:append = " kernel-module-brcmfmac kernel-module-brcmutil kernel-module-brcmfmac-wcc"

# Enable Camera
VIDEO_CAMERA = "1"

KERNEL_MODULE_AUTOLOAD:append = " bcm2835-v4l2"
KERNEL_MODULE_PROBECONF += "bcm2835-v4l2"
KERNEL_DEVICETREE:append = " overlays/ov5647.dtbo"

IMAGE_INSTALL:append = " kernel-module-bcm2835-v4l2"

# Additional Raspberry Pi camera settings
GPU_MEM = "256"
GPU_MEM_256 = "256"
GPU_MEM_512 = "256"
GPU_MEM_1024 = "256"

CONF_VERSION = "2"

# Live streaming (hls)
IMAGE_INSTALL:append = " gstreamer1.0-plugins-ugly"
IMAGE_INSTALL:append = " x264"
PACKAGECONFIG:append:pn-gstreamer1.0-plugins-ugly = " x264"

IMAGE_INSTALL:append = " gstreamer1.0-plugins-bad"
```

## meta-video-surveillance/conf/layer.conf
```bitbake
BBPATH .= ":${LAYERDIR}"

# We have recipes-* directories, add to BBFILES
BBFILES += "${LAYERDIR}/recipes-*/*/*.bb \
            ${LAYERDIR}/recipes-*/*/*.bbappend"

BBFILE_COLLECTIONS += "meta-video-surveillance"
BBFILE_PATTERN_meta-video-surveillance := "^${LAYERDIR}/"
BBFILE_PRIORITY_meta-video-surveillance = "6"

LAYERSERIES_COMPAT_meta-video-surveillance = "scarthgap"
```
